## boards/arm/iris_ce/Kconfig
```kconfig
#
# Copyright (c) 2024 The ZMK Contributors
# SPDX-License-Identifier: MIT
#

config BOARD_IRIS_CE_LEFT
    bool

config BOARD_IRIS_CE_RIGHT
    bool
```

## boards/arm/iris_ce/Kconfig.board
```kconfig
#
# Copyright (c) 2024 The ZMK Contributors
# SPDX-License-Identifier: MIT
#

config BOARD_IRIS_CE_REV1_LEFT
    bool "Iris CE rev1 left"
    depends on SOC_RP2040 
    select BOARD_IRIS_CE_LEFT
    select ZMK_USB
    select RP2_FLASH_W25Q080

config BOARD_IRIS_CE_REV1_RIGHT
    bool "Iris CE rev1 right"
    depends on SOC_RP2040 
    select BOARD_IRIS_CE_RIGHT
    select RP2_FLASH_W25Q080
```

## boards/arm/iris_ce/Kconfig.defconfig
```kconfig
#
# Copyright (c) 2024 The ZMK Contributors
# SPDX-License-Identifier: MIT
#

if BOARD_IRIS_CE_LEFT

config ZMK_KEYBOARD_NAME
    default "Iris CE Rev. 1"

config ZMK_SPLIT_ROLE_CENTRAL
    default y

endif # BOARD_IRIS_CE_LEFT

if BOARD_IRIS_CE_LEFT || BOARD_IRIS_CE_RIGHT
    
config BOARD
    default "iris_ce"

config ZMK_SPLIT
    default y

config SERIAL
    default y

if ZMK_RGB_UNDERGLOW

config WS2812_STRIP
    default y

endif # ZMK_RGB_UNDERGLOW

endif # BOARD_IRIS_CE_LEFT || BOARD_IRIS_CE_RIGHT
```

## boards/arm/iris_ce/iris_ce_rev1_left_defconfig
```kconfig
# Copyright (c) 2024 The ZMK Contributors
# SPDX-License-Identifier: MIT

CONFIG_SOC_SERIES_RP2XXX=y
CONFIG_SOC_RP2040=y
CONFIG_BOARD_IRIS_CE_REV1_LEFT=y
CONFIG_USB_DEVICE_PID=0x1556

CONFIG_SYS_CLOCK_HW_CYCLES_PER_SEC=125000000

# Enable USB CDC ACM logging for debugging
# CONFIG_ZMK_USB_LOGGING=y

# Enable reset by default
CONFIG_RESET=y

# Flash Settings
CONFIG_USE_DT_CODE_PARTITION=y

# Output UF2 by default
CONFIG_BUILD_OUTPUT_UF2=y

# Enable RGB underglow, override some defaults
CONFIG_ZMK_RGB_UNDERGLOW=y
CONFIG_SPI=n # Use PIO

CONFIG_ZMK_RGB_UNDERGLOW_AUTO_OFF_IDLE=y
CONFIG_ZMK_RGB_UNDERGLOW_EXT_POWER=n
CONFIG_ZMK_RGB_UNDERGLOW_BRT_MAX=80
CONFIG_ZMK_RGB_UNDERGLOW_BRT_START=30

CONFIG_ZMK_RGB_UNDERGLOW_ON_START=y
CONFIG_ZMK_RGB_UNDERGLOW_EFF_START=3
```

## boards/keebio/iris_ce/Kconfig.iris_ce_left
```kconfig
#
# Copyright (c) 2024 The ZMK Contributors
# SPDX-License-Identifier: MIT
#

config BOARD_IRIS_CE_LEFT
    select SOC_RP2040 
    select RP2_FLASH_W25Q080
    select ZMK_USB
```

## boards/keebio/iris_ce/Kconfig.iris_ce_right
```kconfig
#
# Copyright (c) 2024 The ZMK Contributors
# SPDX-License-Identifier: MIT
#

config BOARD_IRIS_CE_RIGHT
    select SOC_RP2040 
    select RP2_FLASH_W25Q080
```

## boards/keebio/iris_ce/board.yml
```yaml
boards:
- name: iris_ce_left
  vendor: keebio
  revision:
    format: major.minor.patch
    default: 1.0.0
    exact: true
    revisions:
    - name: 1.0.0
  socs:
  - name: rp2040
- name: iris_ce_right
  vendor: keebio
  revision:
    format: major.minor.patch
    default: 1.0.0
    exact: true
    revisions:
    - name: 1.0.0
  socs:
  - name: rp2040
```

## boards/keebio/iris_ce/iris_ce_right_defconfig
```kconfig
# Copyright (c) 2024 The ZMK Contributors
# SPDX-License-Identifier: MIT

CONFIG_USB_DEVICE_MANUFACTURER="Keebio"
CONFIG_USB_DEVICE_VID=0xCB10
CONFIG_USB_DEVICE_PID=0x1556

CONFIG_SYS_CLOCK_HW_CYCLES_PER_SEC=125000000

# Enable reset by default
CONFIG_RESET=y

# Clock Control
CONFIG_CLOCK_CONTROL=y

# Flash Settings
CONFIG_USE_DT_CODE_PARTITION=y
CONFIG_MPU_ALLOW_FLASH_WRITE=y
CONFIG_NVS=y
CONFIG_SETTINGS_NVS=y
CONFIG_FLASH=y
CONFIG_FLASH_PAGE_LAYOUT=y
CONFIG_FLASH_MAP=y

# Output UF2 by default
CONFIG_BUILD_OUTPUT_UF2=y

# Enable RGB underglow, override some defaults
CONFIG_ZMK_RGB_UNDERGLOW=y
CONFIG_SPI=n # Use PIO

CONFIG_ZMK_RGB_UNDERGLOW_AUTO_OFF_IDLE=y
CONFIG_ZMK_RGB_UNDERGLOW_EXT_POWER=n
CONFIG_ZMK_RGB_UNDERGLOW_BRT_MAX=80
CONFIG_ZMK_RGB_UNDERGLOW_BRT_START=30

CONFIG_ZMK_RGB_UNDERGLOW_ON_START=y
CONFIG_ZMK_RGB_UNDERGLOW_EFF_START=3

CONFIG_ZMK_SPLIT_WIRED_UART_MODE_POLLING=y
CONFIG_ZMK_SPLIT_WIRED_POLLING_RX_PERIOD=3
CONFIG_MAIN_STACK_SIZE=2048
```

## config/west.yml
```yaml
manifest:
  remotes:
    - name: zmkfirmware
      url-base: https://github.com/zmkfirmware
    # Additional modules containing boards/shields/custom code can be listed here as well
    # See https://docs.zephyrproject.org/3.2.0/develop/west/manifest.html#projects
    - name: paulshir
      url-base: https://github.com/paulshir
  projects:
    # - name: zmk
    #   remote: zmkfirmware
    #   revision: main
    #   import: app/west.yml
    - name: zmk
      remote: paulshir
      revision: main+pio-led
      import: app/west.yml
  self:
    path: config
```
